## west.yml
```yaml
#
# Copyright (c) 2026 Nordic Semiconductor ASA
#
# SPDX-License-Identifier: LicenseRef-Nordic-5-Clause
#

manifest:
  remotes:
    - name: ncs
      url-base: https://github.com/nrfconnect
    - name: vegardgu
      url-base: https://github.com/vegardgu

  projects:
    # Revert to sdk-nrf that does not support HID SoftDevice Controller variant
    - name: nrf
      remote: vegardgu
      repo-path: sdk-nrf
      revision: 52c2b7fa266bc4408876b454b55ba709711d048f
      import: true

  self:
    path: hid
```
